## packs/wasm-runtime/br2-external/package/wasmtime/Config.in
```kconfig
config BR2_PACKAGE_WASMTIME_ARCH_SUPPORTS
	bool
	default y if BR2_aarch64
	default y if BR2_x86_64

config BR2_PACKAGE_WASMTIME
	bool "wasmtime"
	depends on BR2_PACKAGE_WASMTIME_ARCH_SUPPORTS
	depends on BR2_TOOLCHAIN_USES_GLIBC
	depends on !BR2_STATIC_LIBS
	depends on BR2_TOOLCHAIN_HAS_THREADS
	help
	  A WebAssembly runtime, from the Bytecode Alliance. Installed from
	  the upstream release binary rather than built: wasmtime is a large
	  Rust program with its own compiler backend, and building it from
	  source means a Rust toolchain and an hour, to produce the binary
	  upstream already publishes.

	  The release carries two binaries, and only the full one, which
	  includes the Cranelift compiler, can run a component. wasmtime-min
	  (4MB) was this package's default until a component was first run
	  under it: the release's min build has component support compiled
	  out as well as the compiler, and fails with "support for components
	  was not enabled at compile time" even on precompiled code. A choice
	  one side of which cannot do this pack's job is a trap, so there is
	  no choice. A small runtime for appliances is a program that embeds
	  wasmtime with exactly the features it needs, not this binary.
	  https://wasmtime.dev
```
