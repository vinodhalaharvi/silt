## br2-external/package/hello-silt/Config.in
```kconfig
config BR2_PACKAGE_HELLO_SILT
	bool "hello-silt"
	help
	  Tiny program that proves a Silt-composed image built and booted.
	  It prints one line and exits; ci/boot-test.sh asserts that line.
```

## packs/agent-gateway/br2-external/package/agent-gateway-host/Config.in
```kconfig
config BR2_PACKAGE_AGENT_GATEWAY_HOST_ARCH_SUPPORTS
	bool
	default y if BR2_aarch64

config BR2_PACKAGE_AGENT_GATEWAY_HOST
	bool "agent-gateway-host"
	depends on BR2_PACKAGE_AGENT_GATEWAY_HOST_ARCH_SUPPORTS
	depends on BR2_INIT_SYSTEMD
	help
	  Serves the gateway component's tools over MCP, and nothing else.
	  It embeds wasmtime, instantiates /opt/components/gateway.wasm, and
	  answers the one function that component imports, silt:modbus/read,
	  from a Modbus TCP device.

	  Installed from a release tarball rather than built here: it is a
	  Rust program embedding wasmtime, and building it in Buildroot would
	  mean a Rust toolchain plus a vendored dependency tree larger than
	  this repository. The source is in packs/agent-gateway/host and
	  release.sh builds what this fetches; the hash beside this file is
	  what ties the two together.
```

## packs/fieldbus-test/br2-external/Config.in
```kconfig
source "$BR2_EXTERNAL_FIELDBUS_TEST_PATH/package/silt-sim/Config.in"
source "$BR2_EXTERNAL_FIELDBUS_TEST_PATH/package/silt-modbus/Config.in"
source "$BR2_EXTERNAL_FIELDBUS_TEST_PATH/package/silt-opcua/Config.in"
source "$BR2_EXTERNAL_FIELDBUS_TEST_PATH/package/silt-can/Config.in"
source "$BR2_EXTERNAL_FIELDBUS_TEST_PATH/package/silt-http/Config.in"
source "$BR2_EXTERNAL_FIELDBUS_TEST_PATH/package/silt-mqtt/Config.in"
```

## packs/fieldbus-test/br2-external/package/hello-modbus/Config.in
```kconfig
config BR2_PACKAGE_HELLO_MODBUS
	bool "hello-modbus"
	depends on BR2_USE_MMU # start-stop-daemon -b forks
	select BR2_PACKAGE_LIBMODBUS
	help
	  A bench Modbus TCP server on port 502, built on libmodbus:
	  a counter in holding register 0 that ticks once a second,
	  0x5117 in register 1, and writable scratch registers and
	  coils. Started at boot.
```

## packs/fieldbus-test/br2-external/package/hello-opcua/Config.in
```kconfig
config BR2_PACKAGE_HELLO_OPCUA
	bool "hello-opcua"
	depends on BR2_USE_MMU # start-stop-daemon -b forks
	select BR2_PACKAGE_OPEN62541
	help
	  A bench OPC UA server on port 4840, built on open62541:
	  anonymous, unencrypted, with a fixed string and a counter
	  that ticks once a second under Objects. Started at boot.
```

## packs/fieldbus-test/br2-external/package/silt-can/Config.in
```kconfig
config BR2_PACKAGE_SILT_CAN
	bool "silt-can"
	depends on BR2_USE_MMU # start-stop-daemon -b forks
	select BR2_PACKAGE_SILT_SIM
	help
	  CAN for the simulated device: the tags that name a can id are
	  packed into frames and sent on the bus, and writable tags can be
	  written from it. Defaults to vcan0, the virtual bus the image
	  brings up at boot.
```

## packs/fieldbus-test/br2-external/package/silt-http/Config.in
```kconfig
config BR2_PACKAGE_SILT_HTTP
	bool "silt-http"
	depends on BR2_USE_MMU # start-stop-daemon -b forks
	select BR2_PACKAGE_SILT_SIM
	select BR2_PACKAGE_LIBMICROHTTPD
	help
	  Push a device config to the board over HTTP on port 8080, and
	  read the live values back as JSON. No authentication and no TLS:
	  the board already serves anonymous OPC UA, unauthenticated Modbus
	  writes and an open CAN bus, so it belongs on a lab network.
```

## packs/fieldbus-test/br2-external/package/silt-modbus/Config.in
```kconfig
config BR2_PACKAGE_SILT_MODBUS
	bool "silt-modbus"
	depends on BR2_USE_MMU # start-stop-daemon -b forks
	select BR2_PACKAGE_SILT_SIM
	select BR2_PACKAGE_LIBMODBUS
	help
	  Modbus TCP on port 502 for the simulated device. Addresses come
	  from the tag table in /dev/shm, so this daemon never reads the
	  config file and cannot disagree with the other protocols about
	  which tag lives where.
```

## packs/fieldbus-test/br2-external/package/silt-mqtt/Config.in
```kconfig
config BR2_PACKAGE_SILT_MQTT
	bool "silt-mqtt"
	depends on BR2_USE_MMU # start-stop-daemon -b forks
	depends on BR2_TOOLCHAIN_HAS_THREADS # paho-mqtt-c
	select BR2_PACKAGE_SILT_SIM
	select BR2_PACKAGE_PAHO_MQTT_C
	select BR2_PACKAGE_MOSQUITTO
	help
	  The device on MQTT: every tag published to the local broker as it
	  changes, on silt/<device>/<tag>, retained, with writes accepted on
	  silt/<device>/<tag>/set. Northbound, the way a gateway publishes
	  what it reads from the field protocols.

comment "silt-mqtt needs a toolchain w/ threads"
	depends on !BR2_TOOLCHAIN_HAS_THREADS
```

## packs/fieldbus-test/br2-external/package/silt-opcua/Config.in
```kconfig
config BR2_PACKAGE_SILT_OPCUA
	bool "silt-opcua"
	depends on BR2_USE_MMU # start-stop-daemon -b forks
	select BR2_PACKAGE_SILT_SIM
	select BR2_PACKAGE_OPEN62541
	help
	  OPC UA on port 4840 for the simulated device. Each tag with an
	  opcua name in the config becomes a variable under Objects, as
	  ns=1;s=<device>.<node>, served from the tag table in /dev/shm.
```

## packs/fieldbus-test/br2-external/package/silt-sim/Config.in
```kconfig
config BR2_PACKAGE_SILT_SIM
	bool "silt-sim"
	depends on BR2_USE_MMU # start-stop-daemon -b forks
	select BR2_PACKAGE_CJSON
	help
	  The simulation core: reads the device config, publishes the tag
	  table into /dev/shm, and moves the simulated values. The protocol
	  daemons read that table, so this is the only program that parses
	  the config, and the only validator of it.
```

## packs/k3s/br2-external/package/k3s/Config.in
```kconfig
config BR2_PACKAGE_K3S_ARCH_SUPPORTS
	bool
	default y if BR2_aarch64
	default y if BR2_x86_64

config BR2_PACKAGE_K3S
	bool "k3s"
	depends on BR2_PACKAGE_K3S_ARCH_SUPPORTS
	depends on BR2_TOOLCHAIN_USES_GLIBC
	depends on BR2_INIT_SYSTEMD
	depends on BR2_USE_MMU
	help
	  Lightweight Kubernetes: a single binary containing the API server,
	  kubelet, containerd, runc, flannel and CoreDNS.

	  The upstream release binary is installed as is; k3s is not built
	  from source here. It is roughly 60MB, so a rootfs of at least 1GB
	  and 2GB of RAM are realistic minimums.

	  https://k3s.io

comment "k3s needs a glibc toolchain, systemd and an MMU"
	depends on BR2_PACKAGE_K3S_ARCH_SUPPORTS
	depends on !BR2_TOOLCHAIN_USES_GLIBC || !BR2_INIT_SYSTEMD || !BR2_USE_MMU
```

## packs/tailscale/br2-external/package/tailscale/Config.in
```kconfig
config BR2_PACKAGE_TAILSCALE
	bool "tailscale"
	depends on BR2_PACKAGE_HOST_GO_TARGET_ARCH_SUPPORTS
	depends on BR2_TOOLCHAIN_HAS_THREADS
	depends on BR2_USE_MMU
	select BR2_PACKAGE_HOST_GO
	select BR2_PACKAGE_CA_CERTIFICATES  # TLS to the coordination server
	help
	  Tailscale: a WireGuard-based mesh VPN that needs no port
	  forwarding and no dynamic DNS, because nodes find each other
	  through a coordination server.

	  Two binaries: tailscaled, the daemon, and tailscale, the
	  command you drive it with. Together they are tens of megabytes,
	  against a few hundred kilobytes for wireguard-tools, because
	  this is a Go program carrying its own WireGuard implementation,
	  its own DNS handling and its own network stack.

	  https://tailscale.com

comment "tailscale needs a toolchain w/ threads"
	depends on !BR2_TOOLCHAIN_HAS_THREADS
```
